## main/Kconfig.projbuild
```kconfig
menu "ReflowCtrl network configuration"

config REFLOW_OTA_SERVER_PORT
    int "OTA server HTTP port"
    range 1 65535
    default 8070

endmenu
```

## sdkconfig.defaults
```kconfig
CONFIG_IDF_TARGET="esp32"
CONFIG_ESPTOOLPY_FLASHSIZE_4MB=y
CONFIG_PARTITION_TABLE_CUSTOM=y
CONFIG_PARTITION_TABLE_CUSTOM_FILENAME="partitions.csv"
CONFIG_ESP_HTTPS_OTA_ALLOW_HTTP=y
CONFIG_LWIP_DNS_SUPPORT_MDNS_QUERIES=y
```
